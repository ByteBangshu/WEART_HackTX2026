## firmware/main/Kconfig.projbuild
```kconfig
menu "WEART board configuration (must match manufacturer schematic)"
config WEART_PINS_CONFIRMED
    bool "I have verified all pin assignments against this exact board"
    default n
config WEART_CAM_D0
    int "Camera D0 GPIO"
    default -1
config WEART_CAM_D1
    int "Camera D1 GPIO"
    default -1
config WEART_CAM_D2
    int "Camera D2 GPIO"
    default -1
config WEART_CAM_D3
    int "Camera D3 GPIO"
    default -1
config WEART_CAM_D4
    int "Camera D4 GPIO"
    default -1
config WEART_CAM_D5
    int "Camera D5 GPIO"
    default -1
config WEART_CAM_D6
    int "Camera D6 GPIO"
    default -1
config WEART_CAM_D7
    int "Camera D7 GPIO"
    default -1
config WEART_CAM_XCLK
    int "Camera XCLK GPIO"
    default -1
config WEART_CAM_PCLK
    int "Camera PCLK GPIO"
    default -1
config WEART_CAM_VSYNC
    int "Camera VSYNC GPIO"
    default -1
config WEART_CAM_HREF
    int "Camera HREF GPIO"
    default -1
config WEART_CAM_SDA
    int "Camera SCCB SDA GPIO"
    default -1
config WEART_CAM_SCL
    int "Camera SCCB SCL GPIO"
    default -1
config WEART_CAM_PWDN
    int "Camera power-down GPIO (-1 if absent)"
    default -1
config WEART_CAM_RESET
    int "Camera reset GPIO (-1 if absent)"
    default -1
config WEART_BUTTON
    int "Button GPIO, active low"
    default -1
config WEART_LED_R
    int "Discrete RGB LED red GPIO (-1 disabled)"
    default -1
config WEART_LED_G
    int "Discrete RGB LED green GPIO (-1 disabled)"
    default -1
config WEART_LED_B
    int "Discrete RGB LED blue GPIO (-1 disabled)"
    default -1
config WEART_DEEP_SLEEP
    bool "Enable deep sleep after 5 idle minutes (RTC button GPIO required)"
    default n
endmenu
```

## firmware/sdkconfig.defaults
```kconfig
CONFIG_IDF_TARGET="esp32s3"
CONFIG_WEART_PINS_CONFIRMED=y
CONFIG_WEART_CAM_D0=11
CONFIG_WEART_CAM_D1=9
CONFIG_WEART_CAM_D2=8
CONFIG_WEART_CAM_D3=10
CONFIG_WEART_CAM_D4=12
CONFIG_WEART_CAM_D5=18
CONFIG_WEART_CAM_D6=17
CONFIG_WEART_CAM_D7=16
CONFIG_WEART_CAM_XCLK=15
CONFIG_WEART_CAM_PCLK=13
CONFIG_WEART_CAM_VSYNC=6
CONFIG_WEART_CAM_HREF=7
CONFIG_WEART_CAM_SDA=4
CONFIG_WEART_CAM_SCL=5
CONFIG_WEART_CAM_PWDN=-1
CONFIG_WEART_CAM_RESET=-1
CONFIG_WEART_BUTTON=0
CONFIG_WEART_LED_R=-1
CONFIG_WEART_LED_G=-1
CONFIG_WEART_LED_B=-1
CONFIG_SPIRAM=y
CONFIG_SPIRAM_MODE_OCT=y
CONFIG_SPIRAM_TYPE_ESPPSRAM64=y
CONFIG_SPIRAM_USE_MALLOC=y
CONFIG_ESP_TASK_WDT_EN=y
CONFIG_ESP_TASK_WDT_INIT=y
CONFIG_ESP_BROWNOUT_DET=y
CONFIG_MBEDTLS_CERTIFICATE_BUNDLE=y
CONFIG_ESP_MAIN_TASK_STACK_SIZE=8192
CONFIG_ESPTOOLPY_FLASHSIZE_16MB=y
CONFIG_PARTITION_TABLE_CUSTOM=y
CONFIG_PARTITION_TABLE_CUSTOM_FILENAME="partitions.csv"
```
